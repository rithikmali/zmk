## app/boards/arm/mali/Kconfig.board
```kconfig
# Copyright (c) 2020 The ZMK Contributors
# SPDX-License-Identifier: MIT

config BOARD_MALI_REV1
	bool "Mali Keyboard"
	depends on SOC_NRF52840_QIAA
```
